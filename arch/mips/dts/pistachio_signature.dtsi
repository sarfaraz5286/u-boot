/*
 * Copyright (C) 2015 Imagination Technologies Ltd.
 *
 * This program is free software; you can redistribute it and/or modify
 * it under the terms of the GNU General Public License version 2 as
 * published by the Free Software Foundation.
 */


/ {
	signature {
		key-dev {
			required = "conf";
			algo = "sha1,rsa2048";
			key-name-hint = "dev";
		};
	};
};
