## board/imgtec/pistachio_bub/Kconfig
```kconfig
if TARGET_PISTACHIO

config SYS_BOARD
	default "pistachio_bub"

config SYS_VENDOR
	default "imgtec"

config SYS_CONFIG_NAME
	default "pistachio"

endif
```

## configs/pistachio_bub_defconfig
```kconfig
CONFIG_MIPS=y
CONFIG_TARGET_PISTACHIO_BUB=y
CONFIG_NETDEVICES=y
CONFIG_CMD_NET=y
CONFIG_MIPS_BOOT_FDT=y
CONFIG_DEFAULT_DEVICE_TREE="pistachio_bub"
CONFIG_DM_ETH=y
CONFIG_CMD_USB=y
CONFIG_MMC=y
CONFIG_OF_CONTROL=y
CONFIG_OF_EMBED=y
CONFIG_USB=y
CONFIG_USB_STORAGE=y
CONFIG_LIB_RAND=y
CONFIG_SPL=y
```

## configs/pistachio_defconfig
```kconfig
CONFIG_MIPS=y
CONFIG_TARGET_PISTACHIO=y
CONFIG_MIPS_BOOT_FDT=y
CONFIG_LIB_RAND=y
```

## configs/pistachio_marduk_defconfig
```kconfig
CONFIG_MIPS=y
CONFIG_TARGET_PISTACHIO_MARDUK=y
CONFIG_MIPS_BOOT_FDT=y
CONFIG_LIB_RAND=y
```

## drivers/mtd/spi-nand/Kconfig
```kconfig
menu "SPI NAND Device Support"

config MTD_SPI_NAND
	bool "SPI NAND device support"
	help
	  This is the framework for the SPI NAND.

endmenu
```
